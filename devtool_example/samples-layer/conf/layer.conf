## devtool_example/samples-layer/conf/layer.conf
```bitbake
# We have a conf and classes directory, append to BBPATH
BBPATH .= ":${LAYERDIR}"

# add ypdd-adv recipes to BBFILES
BBFILES += "${LAYERDIR}/recipes-*/*/*.bb ${LAYERDIR}/*/recipes-*/*/*.bbappend"
BBFILE_COLLECTIONS += "ypdd-adv"
BBFILE_PATTERN_ypdd-adv := "^${LAYERDIR}/"
BBFILE_PRIORITY_ypdd-adv = "5"
```
